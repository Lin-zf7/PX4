## src/examples/serial_app/Kconfig
```kconfig
menuconfig EXAMPLES_SERIAL_APP
	bool "serial_app"
	default n
	---help---
		Enable support for serial_app
```

## src/modules/pwm_hw_out/Kconfig
```kconfig
menuconfig MODULES_PWM_HW_OUT
	bool "pwm_hw_out"
	default n
	---help---
		Simple PWM out example module that toggles a PWM channel.
```

## src/modules/serial_echo/Kconfig
```kconfig
menuconfig MODULES_SERIAL_ECHO
    bool "serial_echo"
    default n
    ---help---
      Enable serial echo module (read input, write same data back)
```
